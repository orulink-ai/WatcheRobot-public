## firmware/sdk/components/protocols/mcu_link/Kconfig
```kconfig
menu "MCU Link"

config WATCHER_MCU_LINK_UART_ENABLE
    bool "Enable runtime UART transport for STM32 coprocessor link"
    default y
    help
        Enables the UART transport scaffold for the STM32 coprocessor runtime
        link. In v2, GPIO19/GPIO20 are reserved for the coprocessor runtime
        UART and this transport is the default runtime owner of those pins.

if WATCHER_MCU_LINK_UART_ENABLE

config WATCHER_MCU_LINK_UART_PORT_NUM
    int "UART port number"
    range 0 2
    default 2
    help
        Dedicated UART controller used for the STM32 runtime link.

config WATCHER_MCU_LINK_UART_TX_GPIO
    int "UART TX GPIO"
    range -1 48
    default 19
    help
        ESP32-S3 TX GPIO for the STM32 runtime link.

config WATCHER_MCU_LINK_UART_RX_GPIO
    int "UART RX GPIO"
    range -1 48
    default 20
    help
        ESP32-S3 RX GPIO for the STM32 runtime link.

config WATCHER_MCU_LINK_UART_BAUD_RATE
    int "UART baud rate"
    range 9600 3000000
    default 921600
    help
        Runtime baud rate for the STM32 coprocessor UART link.

config WATCHER_MCU_LINK_UART_RX_BUFFER
    int "UART RX buffer size"
    range 256 65536
    default 4096
    help
        UART driver RX ring buffer size in bytes.

config WATCHER_MCU_LINK_UART_TX_BUFFER
    int "UART TX buffer size"
    range 0 65536
    default 4096
    help
        UART driver TX ring buffer size in bytes.

endif

endmenu
```
