## firmware/sdk/components/hal/hal_camera/Kconfig
```kconfig
menu "Watcher HAL Camera"

    choice WATCHER_CAMERA_BACKEND
        prompt "HX6538 camera transport"
        default WATCHER_CAMERA_BACKEND_PTL
        help
            Binary PTL is the supported product transport and requires the
            matching custom HX bridge image. Factory SSCMA is retired.

        config WATCHER_CAMERA_BACKEND_SSCMA
            bool "Factory SSCMA JSON/Base64 compatibility (retired)"
            # Retain the symbol for archived source compatibility, never selectable.
            depends on n

        config WATCHER_CAMERA_BACKEND_PTL
            bool "Custom binary PTL transport"
    endchoice

    config WATCHER_CAMERA_CONNECT_TIMEOUT_MS
        int "Camera coprocessor connect timeout (ms)"
        default 5000
        range 1000 30000
        help
            Maximum time to wait for the HX6538 INIT@STAT connect event
            after SSCMA client initialization.

    config WATCHER_CAMERA_CAPTURE_TIMEOUT_MS
        int "One-shot camera capture timeout (ms)"
        default 5000
        range 1000 30000
        help
            Maximum time to wait for a one-shot camera INVOKE result
            containing an image payload.

endmenu
```

## firmware/sdk/examples/robot/sdkconfig.defaults
```kconfig
CONFIG_IDF_TARGET="esp32s3"
CONFIG_ESPTOOLPY_FLASHSIZE_16MB=y
CONFIG_PARTITION_TABLE_CUSTOM=y
CONFIG_PARTITION_TABLE_CUSTOM_FILENAME="partitions.csv"
CONFIG_FREERTOS_HZ=1000
CONFIG_SPIRAM=y
CONFIG_SPIRAM_MODE_OCT=y
CONFIG_SPIRAM_SPEED_80M=y
CONFIG_WATCHER_CAMERA_BACKEND_PTL=y
# CONFIG_BSP_ERROR_CHECK is not set
CONFIG_LV_COLOR_DEPTH_16=y
CONFIG_LV_COLOR_16_SWAP=y
```
